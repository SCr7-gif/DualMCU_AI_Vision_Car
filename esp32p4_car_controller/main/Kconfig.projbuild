## esp32p4_car_controller/main/Kconfig.projbuild
```kconfig
menu "AI Vision Car"

choice ROBOT_NETWORK_BACKEND
    prompt "Network backend"
    default ROBOT_NETWORK_WAVESHARE_P4_WIFI6_KIT
    help
        Select the network hardware backend used by ESP32-P4.

config ROBOT_NETWORK_AUTO
    bool "Auto / native Wi-Fi when available"

config ROBOT_NETWORK_WAVESHARE_P4_WIFI6_KIT
    bool "Waveshare ESP32-P4-WIFI6-KIT external ESP32-C6"
    help
        Use this when the board is Waveshare ESP32-P4-WIFI6-KIT.
        The schematic shows an external ESP32-C6 Wi-Fi 6 module. ESP32-P4
        still needs the matching hosted/remote Wi-Fi driver before the
        network can become online.

config ROBOT_NETWORK_WAVESHARE_P4_ETH
    bool "Waveshare ESP32-P4-ETH RMII IP101"
    help
        Use the Waveshare ESP32-P4-ETH RMII Ethernet wiring:
        MDC GPIO31, MDIO GPIO52, PHY power GPIO51, RMII clock GPIO50,
        IP101 PHY address 1.

endchoice

config ROBOT_WIFI6_KIT_ENABLE_HOSTED
    bool "Enable ESP32-C6 hosted Wi-Fi driver"
    default y
    depends on ROBOT_NETWORK_WAVESHARE_P4_WIFI6_KIT
    help
        Enable the hosted/remote Wi-Fi path used by ESP32-P4-WIFI6-KIT.
        The ESP32-C6 side must run the matching hosted slave firmware.

config ROBOT_CAMERA_V4L2_CAPTURE
    bool "Enable OV5647 V4L2 JPEG capture backend"
    default y
    help
        Enable the ESP32-P4 esp_video based OV5647 MIPI CSI capture backend.

config ROBOT_CAMERA_V4L2_DEVICE
    string "V4L2 camera device path"
    default "/dev/video0"
    depends on ROBOT_CAMERA_V4L2_CAPTURE

config ROBOT_CAMERA_JPEG_WIDTH
    int "JPEG capture width"
    default 320
    depends on ROBOT_CAMERA_V4L2_CAPTURE

config ROBOT_CAMERA_JPEG_HEIGHT
    int "JPEG capture height"
    default 240
    depends on ROBOT_CAMERA_V4L2_CAPTURE

config ROBOT_CAMERA_STREAM_FPS
    int "MJPEG web preview FPS"
    default 6
    range 1 10
    depends on ROBOT_CAMERA_V4L2_CAPTURE

config ROBOT_CAMERA_STREAM_SLOW_FPS
    int "MJPEG web preview FPS while AI is speaking"
    default 2
    range 1 3
    depends on ROBOT_CAMERA_V4L2_CAPTURE

config ROBOT_CAMERA_JPEG_QUALITY
    int "Camera JPEG quality"
    default 50
    range 20 90
    depends on ROBOT_CAMERA_V4L2_CAPTURE

endmenu
```

## esp32p4_car_controller/sdkconfig.defaults
```kconfig
CONFIG_IDF_TARGET="esp32p4"
CONFIG_LOG_DEFAULT_LEVEL_INFO=y
CONFIG_ESP_MAIN_TASK_STACK_SIZE=8192
CONFIG_ESP32P4_SELECTS_REV_LESS_V3=y
CONFIG_ESP32P4_REV_MIN_100=y
# CONFIG_ESP32P4_REV_MIN_301 is not set
CONFIG_ESP32P4_REV_MIN_FULL=100
CONFIG_ESP_REV_MIN_FULL=100
CONFIG_ESP32P4_REV_MAX_FULL=299
CONFIG_ESP_REV_MAX_FULL=299
CONFIG_ESPTOOLPY_FLASHSIZE_32MB=y
CONFIG_SPIRAM=y
CONFIG_PARTITION_TABLE_CUSTOM=y
CONFIG_PARTITION_TABLE_CUSTOM_FILENAME="partitions.csv"
CONFIG_PARTITION_TABLE_FILENAME="partitions.csv"
CONFIG_ROBOT_NETWORK_WAVESHARE_P4_WIFI6_KIT=y
CONFIG_ROBOT_WIFI6_KIT_ENABLE_HOSTED=y
CONFIG_ESP_HOSTED_CP_TARGET_ESP32C6=y
# Waveshare ESP32-P4-WIFI6-KIT uses the same P4<->C6 SDIO pin map as
# Espressif's P4 Function EV board: P4 GPIO18/19/14/15/16/17 -> C6
# GPIO19/18/20/21/22/23, reset on P4 GPIO54 -> C6 CHIP_PU.
# CONFIG_ESP_HOSTED_P4_DEV_BOARD_NONE is not set
CONFIG_ESP_HOSTED_P4_DEV_BOARD_FUNC_BOARD=y
CONFIG_ROBOT_CAMERA_V4L2_CAPTURE=y
CONFIG_ROBOT_CAMERA_V4L2_DEVICE="/dev/video0"
CONFIG_ROBOT_CAMERA_JPEG_WIDTH=320
CONFIG_ROBOT_CAMERA_JPEG_HEIGHT=240
CONFIG_ROBOT_CAMERA_STREAM_FPS=6
CONFIG_ROBOT_CAMERA_STREAM_SLOW_FPS=2
CONFIG_ROBOT_CAMERA_JPEG_QUALITY=50
CONFIG_ESP_VIDEO_ENABLE_MIPI_CSI_VIDEO_DEVICE=y
CONFIG_ESP_VIDEO_ENABLE_ISP_VIDEO_DEVICE=y
CONFIG_ESP_VIDEO_ENABLE_HW_JPEG_VIDEO_DEVICE=y
CONFIG_CAMERA_OV5647=y
CONFIG_CAMERA_OV5647_AUTO_DETECT_MIPI_INTERFACE_SENSOR=y
```
